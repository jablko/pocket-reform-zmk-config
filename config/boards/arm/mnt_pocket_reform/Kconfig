## config/boards/arm/mnt_pocket_reform/Kconfig
```kconfig
config SENSOR_INIT_PRIORITY
    default 90
choice
    prompt "Trigger mode"
config PAT9125_TRIGGER_NONE
    bool "No trigger"
config PAT9125_TRIGGER_GLOBAL_THREAD
    bool "Use global thread"
config PAT9125_TRIGGER_OWN_THREAD
    bool "Use own thread"
endchoice
config PAT9125_THREAD_STACK_SIZE
    int
    default 1024
config PAT9125_THREAD_PRIORITY
    int
    default 10
```

## config/boards/arm/mnt_pocket_reform/dts/bindings/pixart,pat9125el.yaml
```yaml
description: TODO
compatible: pixart,pat9125el
properties:
  int-gpios:
    type: phandle-array
include: i2c-device.yaml
```

## config/boards/arm/mnt_pocket_reform/mnt_pocket_reform_defconfig
```kconfig
CONFIG_SOC_SERIES_RP2XXX=y
CONFIG_SYS_CLOCK_HW_CYCLES_PER_SEC=125000000
CONFIG_BUILD_OUTPUT_UF2=y
CONFIG_ZMK_DISPLAY=y
CONFIG_ZMK_MOUSE=y
```
